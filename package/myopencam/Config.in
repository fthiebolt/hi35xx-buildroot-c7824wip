## package/myopencam/Config.in
```kconfig
# [feb.19] myOpenCam target package
comment "myOpenCam project for C7824WIP"

config BR2_PACKAGE_MYOPENCAM_PREFIX
	string "Install prefix"
	default "/opt/myopencam"
	help
	  Prefix to install myOpenCam on the target file system.

config BR2_PACKAGE_MYOPENCAM
    bool "main app."
    default y
    depends on BR2_PACKAGE_HIMPP_HI3518V100
    help
        myOpenCam main application.

config BR2_PACKAGE_MYOPENCAM_MODULES
    bool "kernel modules"
    default y
    depends on BR2_LINUX_KERNEL
    help
        myOpenCam kernel modules addons. Note that already compiles modules will get installed anyway.

config BR2_PACKAGE_MYOPENCAM_TESTS
    bool "tests apps."
    default n
    depends on BR2_PACKAGE_HIMPP_HI3518V100
    help
        myOpenCam tests applications.

# ---
```
